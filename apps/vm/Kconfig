## apps/vm/Kconfig
```kconfig
#
# Copyright 2017, Data61
# Commonwealth Scientific and Industrial Research Organisation (CSIRO)
# ABN 41 687 119 230.
#
# This software may be distributed and modified according to the terms of
# the BSD 2-Clause license. Note that NO WARRANTY is provided.
# See "LICENSE_BSD2.txt" for details.
#
# @TAG(DATA61_BSD)
#
config APP_CAMKES_VM
    bool "CAmkES VM"
    depends on LIB_SEL4 && LIB_MUSL_C && LIB_SEL4_VKA && LIB_SEL4_ALLOCMAN && LIB_SEL4_PLAT_SUPPORT && \
            LIB_PLATSUPPORT && LIB_SEL4_VSPACE && LIB_ELF && LIB_SEL4_UTILS && LIB_SEL4_SIMPLE && \
            LIB_UTILS && LIB_SEL4_SIMPLE_DEFAULT && LIB_CPIO && LIB_SEL4_ARM_VMM && LIB_SEL4_SYNC && LIB_SEL4_DEBUG && \
            LIB_SEL4_DMA && LIB_USB
    default y

source "projects/vm/components/VM/Kconfig"

config VM_EMMC2_NODMA
    bool "SD access control to prevent DMA"
    depends on APP_CAMKES_VM && PLAT_EXYNOS5410
    default n
    help
        Installs SD card into the VM with read only access. Write access is
        trapped and emulated to ensure that DMA is not used.

config VM_VUSB
    bool "Para-virtual USB driver"
    depends on APP_CAMKES_VM && PLAT_EXYNOS5410
    help
        Selects the device tree which enables the para virtual USB driver and
        installs the device into the VM.

config VM_VCHAN
    bool "Enable vchan connection"
    depends on APP_CAMKES_VM && PLAT_EXYNOS5410
    help
        Enable vchan connection.

choice
    bool "root file system selection"
    depends on APP_CAMKES_VM && PLAT_EXYNOS5410
    default VM_ROOTFS_MMCBLK1P2
    help
        Selects the root device and partition which should be used for the
        root filesystem.

    config VM_ROOTFS_MMCBLK0P2
        bool "mmcblk0p2"
        help
            Selects partition 2 of the on board eMMC as the root filesystem.

    config VM_ROOTFS_MMCBLK1P2
        bool "mmcblk1p2"
        help
            Selects partition 2 of the on removable SD card as the root
            filesystem.

endchoice
```

## components/VM/Kconfig
```kconfig
#
# Copyright 2016, Data61
# Commonwealth Scientific and Industrial Research Organisation (CSIRO)
# ABN 41 687 119 230.
# This software may be distributed and modified according to the terms of
# the BSD 2-Clause license. Note that NO WARRANTY is provided.
# See "LICENSE_BSD2.txt" for details.
# @TAG(DATA61_BSD)
#

choice
    bool "boot mode selection"
    depends on APP_CAMKES_VM && PLAT_TK1
    default VM_TK1_INITRD
    help
        Selects whether to load root file system off emmc or ramdisk

    config VM_TK1_INITRD_ROOTFS
        bool "initrd"
        help
            Selects initrd as the root filesystem.

    config VM_TK1_EMMC_ROOTFS
        bool "mmcblk0p2"
        help
            Selects partition 2 of the emmc card as the root
            filesystem.

endchoice

config TK1_DEVICE_FWD
    bool "Forward VM access to UART and Clock and reset controller"
    depends on APP_CAMKES_VM && PLAT_TK1
    default n
    help
        When using the VM with other components that need access to the UART and clock and reset controller
        devices, this option will cause the vm to forward the faults over a RPC connection

config TK1_INSECURE
    bool "Insecure: Give all devices to VM component"
    depends on APP_CAMKES_VM && PLAT_TK1
    default n
    help
        The option when disabled only passes through UARTD, USB, EMMC, VGIC and a Clock and reset controller
```
